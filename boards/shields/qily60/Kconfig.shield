## boards/shields/qily60/Kconfig.shield
```kconfig
# Copyright (c) 2020 Pete Johanson
# SPDX-License-Identifier: MIT

config SHIELD_QILY60_LEFT
    def_bool $(shields_list_contains,qily60_left)

config SHIELD_QILY60_RIGHT
    def_bool $(shields_list_contains,qily60_right)
```
